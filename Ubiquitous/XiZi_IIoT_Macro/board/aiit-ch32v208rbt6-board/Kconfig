## Ubiquitous/XiZi_IIoT_Macro/board/aiit-ch32v208rbt6-board/Kconfig
```kconfig
mainmenu "XiZi_IIoT Project Configuration"

config BSP_DIR
    string
    option env="BSP_ROOT"
    default "."

config KERNEL_DIR
    string
    option env="KERNEL_ROOT"
    default "../.."

config BOARD_AIIT_CH32V208RBT6_EVB
    bool
    select ARCH_RISCV
    default y  

source "$KERNEL_DIR/arch/Kconfig"

menu "aiit-ch32v208rbt6-board feature"
    source "$BSP_DIR/third_party_driver/Kconfig"
endmenu


menu "Hardware feature"
    source "$KERNEL_DIR/resources/Kconfig"
endmenu

source "$KERNEL_DIR/Kconfig"
```
