## APP_Framework/lib/mqtt/Kconfig
```kconfig
menu "lib using MQTT"

    menuconfig LIB_USING_MQTT
        bool "Enable support MQTT function"
        default n
        select SUPPORT_CONNECTION_FRAMEWORK
        select CONNECTION_ADAPTER_4G

    if LIB_USING_MQTT
        choice 
            prompt "Choose xiuos platform or Alibaba Cloud platform."
            default XIUOS_PLATFORM

            config XIUOS_PLATFORM
                bool "xiuos platform."

            config ALIBABA_PLATFORM
                bool "Alibaba cloud platform."
        endchoice

        if XIUOS_PLATFORM
            menu "xiuos platform mqtt connection parameter configuration."

                config CLIENTID
                    string "mqtt client id."
                    default "D001"

                config USERNAME
                    string "mqtt client username."
                    default "xiuosiot"

                config PASSWORD
                    string "mqtt client login passwd."
                    default "xiuosiot"
            
                config PLATFORM_SERVERIP
                    string "xiuos platform server ip."
                    default "115.238.53.59"

                config PLATFORM_SERVERPORT
                    string "xiuos platform server port."
                    default "1883"
            endmenu

            menuconfig USING_DOWNLOAD_JSON
                bool "Enable support download json file function"
                default n
                select BSP_USING_SDIO
                select MOUNT_SDCARD_FS
                select LIB_USING_CJSON
        endif

        if ALIBABA_PLATFORM
            menu "Alibaba Cloud platform mqtt connection parameter configuration."
                config PLATFORM_PRODUCTKEY
                    string "Product Key, used to identify a product."
                    default "iv74vebCdJC"

                config CLIENT_DEVICENAME
                    string "Device name, used to identify a client device."
                    default "D001"

                config CLIENT_DEVICESECRET
                    string "Device secret, used for device authentication and data encryption."
                    default "d2e613c4f714b6b0774bd7b68eeceae3"
            
                config PLATFORM_SERVERIP
                    string "Alibaba Cloud platform server ip."
                    default "101.133.196.127"

                config PLATFORM_SERVERPORT
                    string "Alibaba Cloud platform server port."
                    default "1883"
            endmenu
        endif
    endif

endmenu
```
