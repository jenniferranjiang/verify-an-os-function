## APP_Framework/Applications/connection_app/Kconfig
```kconfig
menu "connection app"

    menuconfig APPLICATION_CONNECTION
        bool "Using connection apps"
        default n

	if APPLICATION_CONNECTION
		menuconfig SOCKET_DEMO
		bool "Config test socket demo"
		default n

		choice
            prompt "Select Ammeter Device Type"
            default DEVICE_ADL400

            config DEVICE_ADL400
                bool "CH32V208_ADL400"

            config DEVICE_DTZ178
                bool "CH32V208_DTZ178"

            config DEVICE_DTSD342
                bool "CH32V208_DTSD342"
        endchoice
	endif

endmenu
```

## APP_Framework/Applications/webserver/Kconfig
```kconfig
menuconfig APPLICATION_WEBSERVER
    bool "Application webserver using mongoose"
    default n

    if APPLICATION_WEBSERVER
        choice
            prompt "choose board for webserver"
            default APPLICATION_WEBSERVER_XISHUTONG_4G

            config APPLICATION_WEBSERVER_XISHUTONG_4G
                bool "board select xishutong-4g, support dual ethernet port and 4G"
                select BSP_USING_SDIO
                select BSP_USING_W5500
                select BSP_USING_ETHERNET
                select SUPPORT_CONNECTION_FRAMEWORK
                select CONNECTION_ADAPTER_4G
                select ADAPTER_EC200A
                select LIB_USING_LORAWAN
                select LIB_USING_LORA_RADIO

            config APPLICATION_WEBSERVER_XISHUTONG
                bool "board select xishutong, support single ethernet port"
                select BSP_USING_SDIO
                select BSP_USING_LWIP
                select LIB_USING_LORAWAN
                select LIB_USING_LORA_RADIO
        endchoice
    endif
```

## APP_Framework/Framework/connection/4g/Kconfig
```kconfig
config ADAPTER_EC801E
        bool "Using 4G adapter device EC801E"
        default n

if ADAPTER_EC801E
    source "$APP_DIR/Framework/connection/4g/ec801e/Kconfig"
endif

config ADAPTER_EC200T
        bool "Using 4G adapter device EC200T"
        default n

if ADAPTER_EC200T
    source "$APP_DIR/Framework/connection/4g/ec200t/Kconfig"
endif

config ADAPTER_EC200A
        bool "Using 4G adapter device EC200A"
        default n

if ADAPTER_EC200A
    source "$APP_DIR/Framework/connection/4g/ec200a/Kconfig"
endif

config ADAPTER_GM800TF
		bool "Using 4G adapter device GM800TF"
        default n

if ADAPTER_GM800TF
    source "$APP_DIR/Framework/connection/4g/gm800tf/Kconfig"
endif
```

## APP_Framework/Framework/connection/4g/ec200a/Kconfig
```kconfig
config ADAPTER_4G_EC200A
        string "EC200A adapter name"
        default "ec200a"

if ADD_XIZI_FEATURES
        config ADAPTER_EC200A_USING_PWRKEY
                bool "EC200A using PWRKEY pin number"
                default n

        if ADAPTER_EC200A_USING_PWRKEY
                config ADAPTER_EC200A_PWRKEY
                        int "EC200A PWRKEY pin number"
                        default "144"

                config ADAPTER_EC200A_PIN_DRIVER
                        string "EC200A device pin driver path"
                        default "/dev/pin_dev"
        endif

        config ADAPTER_EC200A_DRIVER_EXTUART
                bool "Using extra uart to support 4G"
                default n

        config ADAPTER_EC200A_DRIVER
                string "EC200A device uart driver path"
                default "/dev/usart6_dev6"
                depends on !ADAPTER_EC200A_DRIVER_EXTUART

        if ADAPTER_EC200A_DRIVER_EXTUART                    
                config ADAPTER_EC200A_DRIVER
                        string "EC200A device extra uart driver path"
                        default "/dev/extuart_dev5"

                config ADAPTER_EC200A_DRIVER_EXT_PORT
                        int "if EC200A device using extuart, choose port"
                        default "5"
        endif
endif

if ADD_NUTTX_FEATURES
        config ADAPTER_EC200A_USING_PWRKEY
                bool "EC200A using PWRKEY pin number"
                default n

        if ADAPTER_EC200A_USING_PWRKEY
                config ADAPTER_EC200A_PWRKEY
                        int "EC200A PWRKEY pin number"
                        default "144"

                config ADAPTER_EC200A_PIN_DRIVER
                        string "EC200A device pin driver path"
                        default "/dev/gpio3"
        endif

        config ADAPTER_EC200A_DRIVER_EXTUART
                bool "Using extra uart to support 4G"
                default n

        config ADAPTER_EC200A_DRIVER
                string "EC200A device uart driver path"
                default "/dev/ttyS8"
                depends on !ADAPTER_EC200A_DRIVER_EXTUART

        if ADAPTER_EC200A_DRIVER_EXTUART                    
                config ADAPTER_EC200A_DRIVER
                        string "EC200A device extra uart driver path"
                        default "/dev/extuart_dev5"

                config ADAPTER_EC200A_DRIVER_EXT_PORT
                        int "if EC200A device using extuart, choose port"
                        default "5"
        endif
endif

if ADD_RTTHREAD_FEATURES
        config ADAPTER_EC200A_PWRKEY
                int "EC200A PWRKEY pin number"
                default "144"
        
        config ADAPTER_EC200A_PIN_DRIVER
                string "EC200A device pin driver path"
                default "/dev/pin_dev"

        config ADAPTER_EC200A_DRIVER_EXTUART
                bool "Using extra uart to support 4G"
                default n

        config ADAPTER_EC200A_DRIVER
                string "EC200A device uart driver path"
                default "/dev/usart8"
                depends on !ADAPTER_EC200A_DRIVER_EXTUART

        if ADAPTER_EC200A_DRIVER_EXTUART                    
                config ADAPTER_EC200A_DRIVER
                        string "EC200A device extra uart driver path"
                        default "/dev/extuart_dev5"

                config ADAPTER_EC200A_DRIVER_EXT_PORT
                        int "if EC200A device using extuart, choose port"
                        default "5"
        endif


endif
```

## APP_Framework/Framework/connection/4g/ec801e/Kconfig
```kconfig
config ADAPTER_4G_EC801E
        string "EC801E adapter name"
        default "ec801e"

if ADD_XIZI_FEATURES
        config ADAPTER_EC801E_DRIVER_EXTUART
                bool "Using extra uart to support 4G"
                default n

        config ADAPTER_EC801E_DRIVER
                string "EC801E device uart driver path"
                default "/dev/usart6_dev6"
                depends on !ADAPTER_EC801E_DRIVER_EXTUART

        if ADAPTER_EC801E_DRIVER_EXTUART
                config ADAPTER_EC801E_DRIVER
                        string "EC801E device extra uart driver path"
                        default "/dev/extuart_dev5"

                config ADAPTER_EC801E_DRIVER_EXT_PORT
                        int "if EC801E device using extuart, choose port"
                        default "5"
        endif
endif
```

## APP_Framework/Framework/connection/4g/gm800tf/Kconfig
```kconfig
config ADAPTER_4G_GM800TF
        string "GM800TF adapter name"
        default "gm800tf"

if ADD_XIZI_FEATURES
        config ADAPTER_GM800TF_DEV
                string "GM800TF device path"
                default "/dev/lte_dev1"
endif

if ADD_NUTTX_FEATURES
        config ADAPTER_GM800TF_DEV
                string "GM800TF device path"
                default "/dev/ttyS8"
endif

if ADD_RTTHREAD_FEATURES
        config ADAPTER_GM800TF_DEV
                string "GM800TF device path"
                default "/dev/usart8"
endif
```

## APP_Framework/Framework/connection/ethernet/Kconfig
```kconfig
config ADAPTER_HFA21_ETHERNET
        help
            Please check HFA21 can only work for adapter_wifi or adapter_ethernet in the meantime!
        bool "Using ethernet adapter device HFA21"
        default n
config ADAPTER_WCHNET_ETHERNET
	bool "Using ethernet adapter device WCHNET"
	default n

if ADAPTER_HFA21_ETHERNET
    source "$APP_DIR/Framework/connection/ethernet/hfa21_ethernet/Kconfig"
endif
if ADAPTER_WCHNET_ETHERNET
	source "$APP_DIR/Framework/connection/ethernet/wchnet_ethernet/Kconfig"
endif
```

## APP_Framework/Framework/connection/ethernet/wchnet_ethernet/Kconfig
```kconfig
config ADAPTER_ETHERNET_WCHNET
        string "WCHNET ETHERNET adapter name"
        default "wchnet_ethernet"
```

## APP_Framework/Framework/connection/industrial_fieldbus/Kconfig
```kconfig
config CONNECTION_MODBUS
        bool "Using industrial fieldbus ModBus"
        default n

if CONNECTION_MODBUS
    source "$APP_DIR/Framework/connection/industrial_fieldbus/modbus/Kconfig"
endif
```
