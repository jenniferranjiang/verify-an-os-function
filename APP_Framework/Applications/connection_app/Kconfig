## APP_Framework/Framework/connection/industrial_fieldbus/modbus/Kconfig
```kconfig
choice
        prompt "choose ModBus type"
        default CONNECTION_MODBUS_USING_RTU

        config CONNECTION_MODBUS_USING_RTU
                bool "select ModBus_RTU function"

        config CONNECTION_MODBUS_USING_TCP
                bool "select ModBus_TCP function"
endchoice

if CONNECTION_MODBUS_USING_RTU
        choice
                prompt "choose ModBus_RTU work mode"
                default CONNECTION_MODBUS_USING_RTU_MASTER

                config CONNECTION_MODBUS_USING_RTU_MASTER
                        bool "select ModBus_RTU master mode"

                config CONNECTION_MODBUS_USING_RTU_SLAVE
                        bool "select ModBus_RTU slave mode"
        endchoice
        
        if CONNECTION_MODBUS_USING_RTU_MASTER
                menu "ModBus_RTU Master Register Configure"
                        config X_M_DISCRETE_INPUT_START
                                int "master discrete input start address"
                                default 0

                        config X_M_DISCRETE_INPUT_NDISCRETES
                                int "master discrete input discretes numbers"
                                default 16

                        config X_M_COIL_START
                                int "master coil start address"
                                default 0

                        config X_M_COIL_NCOILS
                                int "master coil numbers"
                                default 64

                        config X_M_REG_INPUT_START
                                int "master input start address"
                                default 0

                        config X_M_REG_INPUT_NREGS
                                int "master input regs numbers"
                                default 100

                        config X_M_REG_HOLDING_START
                                int "master holding start address"
                                default 0

                        config X_M_REG_HOLDING_NREGS
                                int "master holding regs numbers"
                                default 100

                        config X_M_HD_RESERVE
                                int "master holding reserve numbers"
                                default 0

                        config X_M_IN_RESERVE
                                int "master input reserve numbers"
                                default 0

                        config X_M_CO_RESERVE
                                int "master coil reserve numbers"
                                default 0

                        config X_M_DI_RESERVE
                                int "master discrete reserve numbers"
                                default 0
                endmenu
        endif

        if CONNECTION_MODBUS_USING_RTU_SLAVE
                menu "ModBus_RTU Slave Register Configure"
                        config X_S_DISCRETE_INPUT_START
                                int "slave discrete input start address"
                                default 0

                        config X_S_DISCRETE_INPUT_NDISCRETES
                                int "slave discrete input discretes numbers"
                                default 16

                        config X_S_COIL_START
                                int "slave coil start address"
                                default 0

                        config X_S_COIL_NCOILS
                                int "slave coil numbers"
                                default 64

                        config X_S_REG_INPUT_START
                                int "slave input start address"
                                default 0

                        config X_S_REG_INPUT_NREGS
                                int "slave input regs numbers"
                                default 100

                        config X_S_REG_HOLDING_START
                                int "slave holding start address"
                                default 0

                        config X_S_REG_HOLDING_NREGS
                                int "slave holding regs numbers"
                                default 100

                        config X_S_HD_RESERVE
                                int "slave holding reserve numbers"
                                default 0

                        config X_S_IN_RESERVE
                                int "slave input reserve numbers"
                                default 0

                        config X_S_CO_RESERVE
                                int "slave coil reserve numbers"
                                default 0

                        config X_S_DI_RESERVE
                                int "slave discrete reserve numbers"
                                default 0
                endmenu
        endif

        config CONNECTION_MODBUS_RTU_UART_485_DIR
                int "serial 485 direction pin number"
                default "67"

        config CONNECTION_MODBUS_RTU_PIN_DEV
                string "device pin dev path for serial 485 DIR"
                default "/dev/pin_dev"             

        config CONNECTION_MODBUS_RTU_EXTUART
                bool "Using extra uart to support serial 485"
                default n

        config CONNECTION_MODBUS_RTU_UART_DEV
                string "device uart dev path for serial 485"
                default "/dev/usart4_dev4"
                depends on !CONTROL_FRAMEWORK_DRIVER_EXTUART

        if CONTROL_FRAMEWORK_DRIVER_EXTUART                    
                config CONNECTION_MODBUS_RTU_UART_DEV
                        string "device extra uart dev path for serial 485"
                        default "/dev/extuart_dev0"

                config CONNECTION_MODBUS_RTU_UART_DEV_EXT_PORT
                        int "if device using extuart, choose port"
                        default "0"
        endif
endif

if CONNECTION_MODBUS_USING_TCP
        config CONNECTION_MODBUS_USING_TCP_SLAVE
                bool "select ModBus_TCP slave mode"
                default y

        if CONNECTION_MODBUS_USING_TCP_SLAVE
                menu "ModBus_TCP Slave Register Configure"
                        config X_S_DISCRETE_INPUT_START
                                int "slave discrete input start address"
                                default 0

                        config X_S_DISCRETE_INPUT_NDISCRETES
                                int "slave discrete input discretes numbers"
                                default 16

                        config X_S_COIL_START
                                int "slave coil start address"
                                default 0

                        config X_S_COIL_NCOILS
                                int "slave coil numbers"
                                default 64

                        config X_S_REG_INPUT_START
                                int "slave input start address"
                                default 0

                        config X_S_REG_INPUT_NREGS
                                int "slave input regs numbers"
                                default 100

                        config X_S_REG_HOLDING_START
                                int "slave holding start address"
                                default 0

                        config X_S_REG_HOLDING_NREGS
                                int "slave holding regs numbers"
                                default 100

                        config X_S_HD_RESERVE
                                int "slave holding reserve numbers"
                                default 0

                        config X_S_IN_RESERVE
                                int "slave input reserve numbers"
                                default 0

                        config X_S_CO_RESERVE
                                int "slave coil reserve numbers"
                                default 0

                        config X_S_DI_RESERVE
                                int "slave discrete reserve numbers"
                                default 0
                endmenu
        endif
endif
```

## APP_Framework/Framework/control/plc_protocol/Kconfig
```kconfig
config CONTROL_PROTOCOL_FINS
        bool "Using fins control protocol"
        default n
        select CONTROL_USING_SOCKET
if CONTROL_PROTOCOL_FINS
        source "$APP_DIR/Framework/control/plc_protocol/fins/Kconfig"
endif

config CONTROL_PROTOCOL_MELSEC
        bool "Using melsec control protocol"
        default n
if CONTROL_PROTOCOL_MELSEC
        source "$APP_DIR/Framework/control/plc_protocol/melsec/Kconfig"
endif

config CONTROL_PROTOCOL_OPCUA
        bool "Using opcua control protocol"
        default n
if CONTROL_PROTOCOL_OPCUA
        source "$APP_DIR/Framework/control/plc_protocol/opcua/Kconfig"
endif

config CONTROL_PROTOCOL_S7
        bool "Using s7 control protocol"
        default n
        select CONTROL_USING_SOCKET
if CONTROL_PROTOCOL_S7
        source "$APP_DIR/Framework/control/plc_protocol/s7/Kconfig"
endif

config CONTROL_PROTOCOL_CIP
        bool "Using cip control protocol"
        default n
        select CONTROL_USING_SOCKET
if CONTROL_PROTOCOL_CIP
        source "$APP_DIR/Framework/control/plc_protocol/ethernet_ip_cip/Kconfig"
endif
```

## APP_Framework/lib/JerryScript/Kconfig
```kconfig
menu "lib using JerryScript"
    menuconfig LIB_USING_JERRYSCRIPT
        bool "Enable support JerryScript."
        default n
endmenu
```

## APP_Framework/lib/SQLite/Kconfig
```kconfig
menu "lib using SQLite"

    menuconfig LIB_USING_SQLITE
        bool "Using SQLite lib"
        default n
        
    if LIB_USING_SQLITE
        config LIB_SQLITE_EXAMPLE
            bool "Enable SQLite example"
            default y

        config LIB_SQLITE_SQL_MAX_LEN
            int "Set SQL statements max length"
            default 1024

        config LIB_SQLITE_DB_NAME_MAX_LEN
            int "Set SQL database filename fullpath max length"
            default 64
    endif

endmenu
```

## APP_Framework/lib/lorawan/lora_radio_driver/Kconfig
```kconfig
choice
    prompt "choose rtos for lora radio driver"
    default LORA_RADIO_DRIVER_USING_RTOS_XIUOS

    config LORA_RADIO_DRIVER_USING_RTOS_RT_THREAD
        bool "rtos select RT-Thread"

    config LORA_RADIO_DRIVER_USING_RTOS_XIUOS
        bool "rtos select XiUOS"
endchoice

config LORA_RADIO_DRIVER_USING_LORA_RADIO_DEBUG
    bool "lora radio driver debug printf"
    default y

if LORA_RADIO_DRIVER_USING_RTOS_XIUOS
    source "$APP_DIR/lib/lorawan/lora_radio_driver/ports/lora-module/hc32_adapter/Kconfig"
endif
```

## APP_Framework/lib/lorawan/lora_radio_driver/ports/lora-module/hc32_adapter/Kconfig
```kconfig
choice
    prompt "choose lora device module"
    default LORA_RADIO_DRIVER_USING_SX1268_E22400M30S

    config LORA_RADIO_DRIVER_USING_SX1268_E22400M30S
        bool "lora device module select E22-400M30S(SX1268)"

    config LORA_RADIO_DRIVER_USING_SX1278_RA01
        bool "lora device module select RA01(SX1278)"
endchoice

if LORA_RADIO_DRIVER_USING_SX1268_E22400M30S
    source "$APP_DIR/lib/lorawan/lora_radio_driver/ports/lora-module/hc32_adapter/SX1268_E22-400M30S/Kconfig"
endif

if LORA_RADIO_DRIVER_USING_SX1278_RA01
    source "$APP_DIR/lib/lorawan/lora_radio_driver/ports/lora-module/hc32_adapter/SX1278_Ra-01/Kconfig"
endif    
```

## APP_Framework/lib/lorawan/lora_radio_driver/ports/lora-module/hc32_adapter/SX1268_E22-400M30S/Kconfig
```kconfig
choice
    prompt "choose board for lora radio driver"
    default LORA_RADIO_DRIVER_USING_XISHUTONG_ARM32

    config LORA_RADIO_DRIVER_USING_EDU_ARM32
        bool "board select edu-arm32 bsp"

    config LORA_RADIO_DRIVER_USING_XISHUTONG_ARM32
        bool "board select xishutong-arm32 bsp"
endchoice

if LORA_RADIO_DRIVER_USING_EDU_ARM32
        config LORA_SPI_DEV_NAME
                string "lora device pin driver path"
                default "/dev/spi1_dev0"

        config LORA_RADIO_RESET_PIN
                int "hc32 board lora chip reset pin[PI02]"
                default "133"

        config LORA_RADIO_BUSY_PIN
                int "hc32 board lora chip busy pin[PE03]"
                default "2"
endif

if LORA_RADIO_DRIVER_USING_XISHUTONG_ARM32
        config LORA_SPI_DEV_NAME
                string "lora device pin driver path"
                default "/dev/spi2_dev0"

        config LORA_RADIO_BUSY_PIN
                int "xishutong-arm32 board lora chip busy pin[PC12]"
                default "141"

        config LORA_RADIO_RESET_PIN
                int "xishutong-arm32 board lora chip reset pin[PD02]"
                default "144"
endif

config LORA_RADIO_DRIVER_USING_LORA_CHIP_SX126X
        bool "hc32 board using lora chip sx126x"
        default y

if LORA_RADIO_DRIVER_USING_LORA_CHIP_SX126X
        config LORA_RADIO_DRIVER_USING_LORA_CHIP_SX1268
                bool "hc32 board using lora chip sx1268"
                default y
endif
        
```

## APP_Framework/lib/lorawan/lora_radio_driver/ports/lora-module/hc32_adapter/SX1278_Ra-01/Kconfig
```kconfig
config LORA_SPI_DEV_NAME
        string "lora device pin driver path"
        default "/dev/spi1_dev0"

config LORA_RADIO_RESET_PIN
        int "hc32 board lora chip reset pin[PI02]"
        default "133"

config LORA_RADIO_DRIVER_USING_LORA_CHIP_SX127X
        bool "hc32 board using lora chip sx127x"
        default y

if LORA_RADIO_DRIVER_USING_LORA_CHIP_SX127X
        config LORA_RADIO_DRIVER_USING_LORA_CHIP_SX1278
                bool "hc32 board using lora chip sx1278"
                default y
endif
        
```

## APP_Framework/lib/lvgl/examples/Kconfig
```kconfig
menu "lvgl image display parameter settings"
    menuconfig LVGL_WIDTH
        int "Set the width of the image."
        default 320
    menuconfig LVGL_HEIGHT
        int "set the height of the image."
        default 320
endmenu
```
